## package/midibox-blm-proxy/Config.in
```kconfig
config BR2_PACKAGE_MIDIBOX_BLM_PROXY
        bool "midibox-blm-proxy"
        select BR2_PACKAGE_ALSA_LIB
        help
          Install the MIDIbox BLM proxy.

          https://github.com/westlicht/midibox-blm-proxy
```
